## blinky/sdkconfig.defaults
```kconfig
CONFIG_PARTITION_TABLE_CUSTOM=y
CONFIG_PARTITION_TABLE_CUSTOM_FILENAME="partitions.txt"
CONFIG_BOOTLOADER_APP_ROLLBACK_ENABLE=y
CONFIG_ESP_TASK_WDT_TIMEOUT_S=30
CONFIG_ESPTOOLPY_FLASHSIZE_16MB=y
CONFIG_SECURE_SIGNED_APPS_NO_SECURE_BOOT=y
# CONFIG_SECURE_BOOT_BUILD_SIGNED_BINARIES is not set
CONFIG_ESP32_REV_MIN_3_1=y
```
